## conf/distro/openxt.conf
```bitbake
# Down the road this should probably be a machine config thing so it is possible
# to have images that do not include selinux
DISTRO_FEATURES_append = " selinux"

# Force older recipes just to make sure we know when they go upstream
PREFERRED_VERSION_alsa-lib = "1.0.25"
PREFERRED_VERSION_alsa-tools = "1.0.25"
PREFERRED_VERSION_alsa-utils = "1.0.25"
PREFERRED_VERSION_bind = "9.9.5"
PREFERRED_VERSION_bridge-utils = "1.4"
PREFERRED_VERSION_curl = "7.19.7"
PREFERRED_VERSION_curl-native = "7.24.0"
PREFERRED_VERSION_dnsmasq = "2.55"
PREFERRED_VERSION_e2fsprogs = "1.42.1"
PREFERRED_VERSION_iproute2 = "3.12.0"
PREFERRED_VERSION_ipsec-tools = "0.7.2"
PREFERRED_VERSION_libtirpc = "0.2.2"
PREFERRED_VERSION_libxklavier = "5.0"
PREFERRED_VERSION_lvm2 = "2.02.85"
PREFERRED_VERSION_networkmanager = "0.9.2.0"
PREFERRED_VERSION_network-manager-applet = "0.9.2.0"
PREFERRED_VERSION_pango = "1.36.2"
PREFERRED_VERSION_pseudo = "1.3"
PREFERRED_VERSION_vim = "7.2.446"
PREFERRED_VERSION_vim_tiny = "7.2.446"
PREFERRED_VERSION_wpa-supplicant = "0.7.3"

# Define our xserver versions until following upstream
PREFERRED_VERSION_xserver-xorg = "1.11.2"
PREFERRED_VERSION_libpciaccess = "0.12.902"
PREFERRED_VERSION_libsm = "1.2.1"
PREFERRED_VERSION_xf86-video-fbdev = "0.4.2"


# Define SELinux versions
PREFERRED_VERSION_checkpolicy = "2.3"
PREFERRED_VERSION_libselinux = "2.3"
PREFERRED_VERSION_libsemanage = "2.3"
PREFERRED_VERSION_libsepol = "2.3"
PREFERRED_VERSION_policycoreutils = "2.3"
PREFERRED_VERSION_sepolgen = "1.2.1"

# We need a version higher than in OE for certain settings
PREFERRED_VERSION_dialog = "1.2-20150125"

# These were not pulled but there are multiple versions available.
PREFERRED_VERSION_kmod = "7"
PREFERRED_VERSION_rsync = "3.1.0"
PREFERRED_VERSION_syslinux = "4.04"

PREFERRED_PROVIDER_alsa-utils-alsaconf = "alsa-utils"
PREFERRED_PROVIDER_ntpdate = "ntp"
PREFERRED_PROVIDER_sysvinit-inittab = "sysvinit"

PREFERRED_VERSION_midori = "0.1.8"
PREFERRED_VERSION_webkit-gtk = "1.8.3"

######################################################################
# Forcing upstream versions here when it appears our old version     #
# will just not work.                                                #
######################################################################
PREFERRED_VERSION_libsoup-2.4 = "2.45.3"

######################################################################
# Java pieces.  Using jamvm-inital causes random crashs using jamvm. #
######################################################################
PREFERRED_PROVIDER_virtual/java-initial = "cacao-initial"
PREFERRED_PROVIDER_virtual/java-native = "jamvm-native"
PREFERRED_PROVIDER_virtual/javac-native = "ecj-bootstrap-native"
```
